## sdkconfig.defaults
```kconfig
# Partition Table
CONFIG_PARTITION_TABLE_CUSTOM=y
CONFIG_PARTITION_TABLE_CUSTOM_FILENAME="partitions.csv"
CONFIG_PARTITION_TABLE_FILENAME="partitions.csv"

# SPIFFS Config
CONFIG_SPIFFS_MAX_PARTITIONS=1

# LWIP Config
CONFIG_LWIP_MAX_SOCKETS=16
CONFIG_LWIP_SO_REUSE=y

# HTTP Server Config
CONFIG_HTTPD_MAX_REQ_HDR_LEN=1024
CONFIG_HTTPD_MAX_URI_LEN=128

# WiFi Config
CONFIG_ESP_WIFI_SSID="ESP32_Robot_AP"
CONFIG_ESP_WIFI_PASSWORD="12345678"
CONFIG_ESP_WIFI_CHANNEL=1
CONFIG_ESP_MAX_STA_CONN=4

# Log Config
CONFIG_LOG_DEFAULT_LEVEL_INFO=y 
```
